/*
 * Copyright (c) 2026 EPAM Systems
 *
 * SPDX-License-Identifier: Apache-2.0
 */

#include "xenvm.dts"

&{/cpus} {
	cpu@1 {
		device_type = "cpu";
		compatible = "arm,armv8";
		enable-method = "psci";
		reg = <0x01>;
	};
};
