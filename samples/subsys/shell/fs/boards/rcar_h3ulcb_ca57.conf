## samples/subsys/shell/fs/boards/rcar_h3ulcb_ca57.conf
```kconfig
#
# Copyright (c) 2023 EPAM Systems
#
# SPDX-License-Identifier: Apache-2.0
#
CONFIG_FS_LITTLEFS_FC_HEAP_SIZE=8192

CONFIG_DISK_ACCESS=y
CONFIG_RCAR_MMC=y

CONFIG_FS_LITTLEFS_BLK_DEV=y
CONFIG_FS_LITTLEFS_FMP_DEV=n
```
